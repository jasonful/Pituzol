## main/Kconfig.projbuild
```kconfig
menu "Example Configuration"

config WIFI_SSID
    string "WiFi SSID"
	default "myssid"
	help
		SSID (network name) for the example to connect to.

config WIFI_PASSWORD
    string "WiFi Password"
    default "mypassword"
	help
		WiFi password (WPA or WPA2) for the example to use.

		Can be left blank if the network has no security set.

config PANDORA_USERNAME
	string "Pandora username"
	default "enter your Pandora username here"
	help
		Pandora account username

config PANDORA_PASSWORD
	string "Pandora password"
	default "enter your Pandora password here"
	help
		Pandora account password

config USE_BUILTIN_DAC
	bool "Use built-in DAC"
	default y
	help
		Use ESP32's builtin DAC for audio output.  If disabled, you need to use an audio board such
		as the LyraT or AI-Thinker A1S, and set the Audio HAL settings
		
endmenu
```
